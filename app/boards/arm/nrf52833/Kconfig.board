## app/boards/arm/nrf52833/Kconfig.board
```kconfig
# Copyright (c) 2026 Miguelio
# SPDX-License-Identifier: MIT

config BOARD_NRF52833
    bool "nrf52833"
    depends on SOC_NRF52833_QIAA
```

## app/boards/arm/nrf52833/Kconfig.defconfig
```kconfig
# Copyright (c) 2026 Miguelio
# SPDX-License-Identifier: MIT

if BOARD_NRF52833

config BT_CTLR
    default BT

endif # BOARD_NRF52833
```
