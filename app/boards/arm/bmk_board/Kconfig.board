## app/boards/arm/bmk_board/Kconfig.board
```kconfig
# Copyright (c) 2025 Miguelio
# SPDX-License-Identifier: MIT

config BOARD_BMK_BOARD
    bool "bmk_board"
    depends on SOC_NRF52840_QIAA
```

## app/boards/arm/bmk_board/Kconfig.defconfig
```kconfig
# Copyright (c) 2025 Miguelio
# SPDX-License-Identifier: MIT

if BOARD_BMK_BOARD

config BT_CTLR
    default BT

endif # BOARD_BMK_BOARD
```

## app/boards/arm/nrf52840/Kconfig.board
```kconfig
# Copyright (c) 2026 Miguelio
# SPDX-License-Identifier: MIT

config BOARD_NRF52840
    bool "nrf52840"
    depends on SOC_NRF52840_QIAA
```

## app/boards/arm/nrf52840/Kconfig.defconfig
```kconfig
# Copyright (c) 2026 Miguelio
# SPDX-License-Identifier: MIT

if BOARD_NRF52840

config BT_CTLR
    default BT

endif # BOARD_NRF52840
```

## app/boards/arm/nrf52840/nrf52840_defconfig
```kconfig
# Copyright (c) 2025 Miguelio
# SPDX-License-Identifier: MIT

CONFIG_SOC_SERIES_NRF52X=y
CONFIG_SOC_NRF52840_QIAA=y
CONFIG_BOARD_NRF52840=y

# Enable MPU
CONFIG_ARM_MPU=y

CONFIG_PINCTRL=y

# Enable GPIO
CONFIG_GPIO=y

CONFIG_USE_DT_CODE_PARTITION=y
CONFIG_BUILD_OUTPUT_UF2=y

CONFIG_MPU_ALLOW_FLASH_WRITE=y
CONFIG_NVS=y
CONFIG_SETTINGS_NVS=y
CONFIG_FLASH=y
CONFIG_FLASH_PAGE_LAYOUT=y
CONFIG_FLASH_MAP=y
CONFIG_CLOCK_CONTROL_NRF=y
CONFIG_CLOCK_CONTROL_NRF_K32SRC_RC=y

CONFIG_SPI=y
CONFIG_LED_STRIP=y
CONFIG_WS2812_STRIP=y
```
